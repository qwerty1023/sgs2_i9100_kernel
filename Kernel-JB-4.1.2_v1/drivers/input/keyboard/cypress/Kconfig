## Kernel-JB-4.1.2_v1/drivers/input/keyboard/cypress/Kconfig
```kconfig
#
# Cypress touchkey configuration
#

config KEYBOARD_CYPRESS_TOUCH
	tristate "Cypress touchkey support"
	help
	  Say Y here to enable the cypress touchkey.

	  To compile this driver as a module, choose M here.

config TOUCHKEY_BLN
	bool "For SAMMY ROMs - with BLN support"
	depends on KEYBOARD_CYPRESS_TOUCH || KEYBOARD_CYPRESS_AOSP
	help
	   Samsung ROMs BLN support.
```
